#include <hidef.h>      
#include "derivative.h"      

#define delay(d); for (delay = d/2; delay != 0; delay--) asm NOP;

unsigned int delay; 

void main() 
{
	DDRB = 0xF0;			//	установка линий порта младшей части на ввод, старшей на вывод
	PUCR |= 0x02;			// 	включение подтягивающих регистров к порту В
	PORTB = 0xF0;			// 	выключение лампочек

	ATDCTL2 |= 0x82; //	Включение АЦП и прерываний по завершению его преобразований. 

	delay(50); // 	Задержка в 50 мкс. Необходима для того, чтобы аналоговые компоненты АЦП пришли в рабочее состояние после его включения. 

	//	Установка количества преобразований в каждой последовательности равным единице
	//	Это необходимо, чтобы успеть разглядеть зажигание светодиодов
	ATDCTL3 = 0x08;			//	установка частоты тактирования (fclock/2 = 2МГЦ) и 8-битного разрешения АЦП
	ATDCTL4 |= 0x80;		//	Выбор в качестве линии аналогового ввода ножки 5 порта AD. 
	//	Установка одноканального режима работы и однократного сканирования АЦП выбранного входа.  
	ATDCTL5 = 0x05; 
	EnableInterrupts; //	разрешение прерываний

	for(;;) 
	{ 
	  _FEED_COP();
	}
}

interrupt 22 void ATD0() //	функция прерывания
{
	if((ATDDR0H >= 0) && (ATDDR0H < 51))
	{
		PORTB = 0b11110000;
	}
	else if((ATDDR0H >= 51) && (ATDDR0H < 102))
	{
		PORTB = 0b01110000;
	}
	else if((ATDDR0H >= 102) && (ATDDR0H < 153))
	{
		PORTB = 0b00110000;
	}
	else if((ATDDR0H >= 153) && (ATDDR0H < 204))
	{
		PORTB = 0b00010000;
	}
	else if(ATDDR0H >= 204)
	{
		PORTB = 0b00000000;
	}

	ATDCTL5 = 0x05; 	// 	возобновление работы модуля
}
